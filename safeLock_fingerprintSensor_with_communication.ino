#include <Adafruit_Fingerprint.h>   // Fingerprint sensor library
#include <HardwareSerial.h>
#include <Adafruit_GFX.h>           // Graphics library for OLED
#include <Adafruit_SSD1306.h>       // OLED display library
#include <SPI.h>
#include <Wire.h>
#include <ESP32Servo.h>
#include "ThingSpeak.h"
#include "WiFi.h"

// === OLED Display Configuration ===
#define SCREEN_WIDTH 128
#define SCREEN_HEIGHT 64
#define OLED_RESET     -1

Adafruit_SSD1306 display(SCREEN_WIDTH, SCREEN_HEIGHT, &Wire, OLED_RESET);

// === Fingerprint Logo Icon (Bitmap) ===
#define LOGO_HEIGHT   64
#define LOGO_WIDTH    128
static const unsigned char PROGMEM logo_bmp[] =
{
  0x00, 0x00, 0x00, 0x00, 0x00, 0x00, 0x00, 0x00, 0x00, 0x00, 0x00, 0x00, 0x00, 0x00, 0x00, 0x00,
  0x00, 0x00, 0x00, 0x00, 0x00, 0x00, 0x00, 0x00, 0x00, 0x00, 0x00, 0x00, 0x00, 0x00, 0x00, 0x00,
  0x00, 0x00, 0x00, 0x00, 0x00, 0x00, 0x03, 0xff, 0xc0, 0x00, 0x00, 0x00, 0x00, 0x00, 0x00, 0x00,
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  0x00, 0x00, 0x00, 0x00, 0x00, 0x00, 0x00, 0x00, 0x00, 0x00, 0x00, 0x00, 0x00, 0x00, 0x00, 0x00
};

// === Pins and Serial Setup ===
HardwareSerial SerialPort(2);  // UART2 for fingerprint sensor
#define RX_PIN 32
#define TX_PIN 33
#define LED_R 19
#define LED_Y 18
#define LED_G 2
#define SERVO_PIN 5
#define BUZZER_PIN 15

// === Timing Constants ===
const unsigned long oneMinute = 60000;
const unsigned long waitingTime = 10000;

// === Fingerprint Sensor Instance ===
Adafruit_Fingerprint finger = Adafruit_Fingerprint(&SerialPort);

Servo servo;


// === State Variables ===
unsigned long lastRecognizedTime = -waitingTime;  // Init to allow first scan
int ledsModes[3] = {0, 0, 0};  // R, Y, G


const char ssid[] = "foadphone";  // my network SSID (name)
const char pass[] = "jijq6787";   // my network password    
WiFiClient  client;

//---------Channel Details---------//
unsigned long counterChannelNumber = 2912544;            // Channel ID
const char * myCounterReadAPIKey = "ZT2YGN9J05J73YMB"; // Read API Key
const int FieldNumber1 = 1;  // The field we want to read


// === Function Declarations ===
void setLedsMode(int modes[3]);
int getFingerprintIDez();

void setup()
{
 pinMode(BUZZER_PIN, OUTPUT);
 
 digitalWrite(BUZZER_PIN, LOW);
 
  Serial.begin(115200);
  WiFi.mode(WIFI_STA);
  ThingSpeak.begin(client);

  SerialPort.begin(57600, SERIAL_8N1, RX_PIN, TX_PIN);
  if(!display.begin(SSD1306_SWITCHCAPVCC, 0x3C)) 
  { 
    for(;;); // Don't proceed, loop forever
  }
 
 while (!Serial); 
 delay(100);
 
 display.clearDisplay();
 display.drawBitmap(0, 0, logo_bmp, LOGO_WIDTH, LOGO_HEIGHT, 1);
 display.display();
 
 delay(1000);
 display.clearDisplay();
 
 // set the data rate for the sensor serial port
 finger.begin(57600);
 
 if (finger.verifyPassword()) 
 {
   Serial.println("Fingerprint Sensor Connected");
   display.clearDisplay();
   display.setTextSize(2);             // Normal 1:1 pixel scale
   display.setTextColor(SSD1306_WHITE);        // Draw white text
   display.setCursor(25, 0);            // Start at top-left corner
   display.println(("Sensor"));
   display.setCursor(5, 35);
   display.println("Connected");
   display.display();

 }
 
 else  
 {
   display.clearDisplay();
   display.setTextSize(2);             // Normal 1:1 pixel scale
   display.setTextColor(SSD1306_WHITE);        // Draw white text
   display.setCursor(25, 0);            // Start at top-left corner
   display.println(("Sensor"));
   display.setCursor(5, 35);
   display.println("Not Found");
   display.display();
   
   Serial.println("Unable to find Sensor");
   delay(1000);
   Serial.println("Check Connections");
 
   while (1) {
     delay(1);
   }
 }
  display.clearDisplay();
  pinMode(LED_R, OUTPUT);
  pinMode(LED_Y, OUTPUT);
  pinMode(LED_G, OUTPUT);
  setLedsMode(ledsModes);
  servo.attach(SERVO_PIN);  // Attach the servo to it's pin
  servo.write(0);
}

void loop()
 {
  //----------------- Network -----------------//
  if (WiFi.status() != WL_CONNECTED)
  {
    Serial.print("Connecting to ");
    Serial.print(ssid);
    Serial.println(" ....");
    while (WiFi.status() != WL_CONNECTED)
    {
      WiFi.begin(ssid, pass);
      delay(5000);
    }
    Serial.println("Connected to Wi-Fi Succesfully.");
  }
  //--------- End of Network connection--------//
 
 //---------------- Channel 1 ----------------//
  Serial.print("Reading field 1 ");
  long R_Status = ThingSpeak.readLongField(counterChannelNumber, FieldNumber1, myCounterReadAPIKey);
  int statusCode = ThingSpeak.getLastReadStatus();
  if (statusCode == 200)
  {
    Serial.print("Read field 1 Successful ");
 
  }
  else
  {
    Serial.println("Unable to read channel / No internet connection");
  }
 Serial.println(R_Status);
  if(R_Status==1)
  {
       getFingerprintIDez();

  }

}

// === Fingerprint Scan Handler ===
int getFingerprintIDez() {
  long enterTime = millis();
  uint8_t p = finger.getImage();
  if(millis() - enterTime > oneMinute/3)
    return -1;
  if (p != FINGERPRINT_OK) {
    display.clearDisplay();
    display.drawBitmap(0, 0, logo_bmp, LOGO_WIDTH, LOGO_HEIGHT, 1);
    display.display();
    return -1;
  }

  p = finger.image2Tz();
  if (p != FINGERPRINT_OK) {
    display.clearDisplay();
    display.setTextSize(2);
    display.setTextColor(SSD1306_WHITE);
    display.setCursor(0, 0);
    display.println("Messy  Image");
    display.setCursor(0, 35);
    display.println("Try Again");
    display.display();
    delay(1000);
    display.clearDisplay();
    return -1;
  }

  p = finger.fingerFastSearch();
  unsigned long now = millis();

  if (p != FINGERPRINT_OK) {
    digitalWrite(LED_R, HIGH);
    digitalWrite(BUZZER_PIN, HIGH);

    display.clearDisplay();
    display.setTextSize(2);
    display.setTextColor(SSD1306_WHITE);
    display.setCursor(20, 0);
    display.println("Invalid");
    display.setCursor(25, 20);
    display.println("Finger");
    display.setCursor(10, 40);
    display.println("Try Again");
    display.display();
    Serial.println("Not Valid Finger");

    delay(2000);
    digitalWrite(LED_R, LOW);
    digitalWrite(BUZZER_PIN, LOW);
    display.clearDisplay();
    return -1;
  }

  // Valid fingerprint: apply cooldown
  if (now - lastRecognizedTime < waitingTime) {
    unsigned long remainingTime = waitingTime - (now - lastRecognizedTime);
    digitalWrite(LED_Y, HIGH);

    for (int i = remainingTime / 1000; i > 0; i--) {
      display.clearDisplay();
      display.setTextSize(2);
      display.setTextColor(SSD1306_WHITE);
      display.setCursor(0, 0);
      display.println("Too Soon!");
      display.setCursor(0, 20);
      display.println("Wait:");
      display.setCursor(60, 20);
      display.print(i);
      display.println("s");
      display.setCursor(0, 45);
      display.println("Try Later");
      display.display();
      Serial.print("Wait: ");
      Serial.print(i);
      Serial.println("s");
      delay(1000);
    }
    digitalWrite(LED_Y, LOW);
    display.clearDisplay();
  }
    
  // Success!
  lastRecognizedTime = now;
  int ledMode[] = {0, 0, 1};
  setLedsMode(ledMode);

  display.clearDisplay();
  display.setTextSize(2);
  display.setTextColor(SSD1306_WHITE);
  display.setCursor(40, 0);
  display.println("Door");
  display.setCursor(15, 20);
  display.println("Unlocked");
  display.setCursor(20, 40);
  display.println("Welcome");
  display.display();

  servo.write(90);
  delay(waitingTime / 2);

  display.clearDisplay();
  display.setTextSize(2);
  display.setCursor(20, 10);
  display.println("Closing");
  display.setCursor(20, 30);
  display.println("the Door");
  display.display();

  servo.write(0);
  display.clearDisplay();
  Serial.println("Door Unlocked Welcome");

  return finger.fingerID;
}

//Set leds states
void setLedsMode(int modes[3]) {
  digitalWrite(LED_R, modes[0] ? HIGH : LOW);  
  digitalWrite(LED_Y, modes[1] ? HIGH : LOW);   
  digitalWrite(LED_G, modes[2] ? HIGH : LOW);   

  delay(waitingTime / 2);

  digitalWrite(LED_R, LOW);  
  digitalWrite(LED_Y, LOW);   
  digitalWrite(LED_G, LOW);   
}
